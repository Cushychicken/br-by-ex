/dts-v1/;
/plugin/;

/ {
    compatible = "brcm,bcm2835"; /* Compatibility string for RPi4 */

    fragment@0 {
        target = <&i2c1>;
        __overlay__ {
            #address-cells = <1>;
            #size-cells = <0>;

            rfd77402@4c {
                compatible = "raydium,rfd77402";
                reg = <0x4c>;
                status = "okay";
            };
        };
    };
};

