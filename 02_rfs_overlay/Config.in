## 02_rfs_overlay/Config.in
```kconfig
source "package/Config.in"

config BR2_PACKAGE_BASIC_RFS_OVERLAY_RPI4
    bool "Basic out of tree buildroot project for RPi 4 with rootfs overlay"
    help
      Example support for rootfs overlay in RPi4 out-of-tree project 
```

## 04_dts_and_cfg_frag/Config.in
```kconfig
source "package/Config.in"

config BR2_PACKAGE_BASIC_EXT_RPI4
    bool "Basic out of tree buildroot project for RPi 4"
    help
      Enable support for RPi4 out-of-tree project with external toolchain
```

## 06_custom_app/configs/06_custom_app_defconfig
```kconfig
BR2_arm=y
BR2_cortex_a72=y
BR2_ARM_FPU_NEON_VFPV4=y
BR2_GLOBAL_PATCH_DIR="board/raspberrypi/patches"
BR2_DOWNLOAD_FORCE_CHECK_HASHES=y
BR2_SYSTEM_DHCP="eth0"
BR2_ROOTFS_POST_IMAGE_SCRIPT="board/raspberrypi4/post-image.sh"
BR2_LINUX_KERNEL=y
BR2_LINUX_KERNEL_CUSTOM_TARBALL=y
BR2_LINUX_KERNEL_CUSTOM_TARBALL_LOCATION="$(call github,raspberrypi,linux,576cc10e1ed50a9eacffc7a05c796051d7343ea4)/linux-576cc10e1ed50a9eacffc7a05c796051d7343ea4.tar.gz"
BR2_LINUX_KERNEL_DEFCONFIG="bcm2711"
BR2_LINUX_KERNEL_DTS_SUPPORT=y
BR2_LINUX_KERNEL_INTREE_DTS_NAME="broadcom/bcm2711-rpi-4-b broadcom/bcm2711-rpi-400 broadcom/bcm2711-rpi-cm4 broadcom/bcm2711-rpi-cm4s"
BR2_LINUX_KERNEL_NEEDS_HOST_OPENSSL=y
BR2_PACKAGE_BUSYBOX_SHOW_OTHERS=y
BR2_PACKAGE_XZ=y
BR2_PACKAGE_ASCII_INVADERS=y
BR2_PACKAGE_RPI_FIRMWARE=y
BR2_PACKAGE_RPI_FIRMWARE_VARIANT_PI4=y
BR2_PACKAGE_KMOD=y
BR2_PACKAGE_KMOD_TOOLS=y
BR2_TARGET_ROOTFS_EXT2=y
BR2_TARGET_ROOTFS_EXT2_4=y
BR2_TARGET_ROOTFS_EXT2_SIZE="120M"
# BR2_TARGET_ROOTFS_TAR is not set
BR2_PACKAGE_HOST_DOSFSTOOLS=y
BR2_PACKAGE_HOST_GENIMAGE=y
BR2_PACKAGE_HOST_KMOD_XZ=y
BR2_PACKAGE_HOST_MTOOLS=y

##################################################
### Everything above this line is RPi4 default ###
##################################################

### Configures buildroot to use external toolchain from tarball 
BR2_TOOLCHAIN_EXTERNAL=y
BR2_TOOLCHAIN_EXTERNAL_CUSTOM=y
BR2_TOOLCHAIN_EXTERNAL_DOWNLOAD=y
BR2_TOOLCHAIN_EXTERNAL_URL="file://${BR2_EXTERNAL}/../tools/arm-buildroot-linux-gnueabihf_sdk-buildroot.tar.gz"
BR2_TOOLCHAIN_EXTERNAL_GCC_13=y
BR2_TOOLCHAIN_EXTERNAL_HEADERS_6_6=y
BR2_TOOLCHAIN_EXTERNAL_CUSTOM_GLIBC=y
# BR2_TOOLCHAIN_EXTERNAL_INET_RPC is not set
BR2_TOOLCHAIN_EXTERNAL_CXX=y

######################################################
### br-by-ex - customizations from prior exercises ###
######################################################

BR2_ROOTFS_OVERLAY="${BR2_EXTERNAL}/overlay"
BR2_PACKAGE_RPI_FIRMWARE_CONFIG_FILE="${BR2_EXTERNAL}/board/rpi4/config_4.txt"
BR2_LINUX_KERNEL_CONFIG_FRAGMENT_FILES="${BR2_EXTERNAL}/board/rpi4/linux/linux.config"
BR2_LINUX_KERNEL_CUSTOM_DTS_DIR="${BR2_EXTERNAL}/board/rpi4/dtso"
BR2_ROOTFS_POST_BUILD_SCRIPT="board/raspberrypi4/post-build.sh ${BR2_EXTERNAL}/board/rpi4/post-build.sh"

#############################################
### br-by-ex 06_custom_app customizations ###
#############################################

# includes our new package that we've added under packages/ directory
BR2_PACKAGE_CLOSEBLINK=y
```

## 06_custom_app/package/closeblink/Config.in
```kconfig
config BR2_PACKAGE_CLOSEBLINK
        bool "closeblink"
        default y
        help
          A application that reads an IIO sensor and blinks an LED if the 
          value is below a threshold.

          https://www.nodocs.com
```
